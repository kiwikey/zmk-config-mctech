## config/west.yml
```yaml
manifest:

  remotes:
    # default ZMK
    - name: zmkfirmware
      url-base: https://github.com/zmkfirmware
    # dongle_display
    - name: englmaxi
      url-base: https://github.com/englmaxi
    # nice_oled - nice_epaper - dongle_display!view - oled Adapter
    - name: mctechnology17
      url-base: https://github.com/mctechnology17
    # nice_oled - nice_epaper
    - name: kiwikey
      url-base: https://github.com/kiwikey
    # zmk-raw-hid
    - name: zzeneg
      url-base: https://github.com/zzeneg

  projects:
    # default ZMK
    - name: zmk
      remote: zmkfirmware
      revision: main
      import: app/west.yml
    # dongle_display
    - name: zmk-dongle-display
      remote: kiwikey
      revision: dev_testing01
    # nice_oled - nice_epaper
    - name: zmk-nice-oled
      remote: kiwikey
      revision: dev_testing01
    # dongle_display!view
    - name: zmk-dongle-display-view
      remote: mctechnology17
      revision: main
    # oled adapter
    - name: zmk-oled-adapter
      remote: mctechnology17
      revision: main
    # zmk-raw-hid
    - name: zmk-raw-hid # <-- new entry
      remote: zzeneg
      revision: main

  self:
    path: config
```
